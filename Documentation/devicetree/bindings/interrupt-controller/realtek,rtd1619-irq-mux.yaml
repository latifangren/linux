## Documentation/devicetree/bindings/interrupt-controller/realtek,rtd1619-irq-mux.yaml
```yaml
# SPDX-License-Identifier: (GPL-2.0-only OR BSD-2-Clause)
%YAML 1.2
---
$id: http://devicetree.org/schemas/interrupt-controller/realtek,rtd1619-irq-mux.yaml#
$schema: http://devicetree.org/meta-schemas/core.yaml#

title: Realtek RTD1619 interrupt mux controller

maintainers:
  - Realtek Linux Kernel Team <linux-kernel@realtek.com>

properties:
  compatible:
    const: realtek,rtd1619-irq-mux

  reg:
    minItems: 1
    maxItems: 2

  interrupts:
    minItems: 1
    maxItems: 2

  realtek,mux-nr:
    $ref: /schemas/types.yaml#/definitions/uint32
    minimum: 1
    maximum: 2
    description: Number of mux blocks.

  realtek,intr-status:
    $ref: /schemas/types.yaml#/definitions/uint32-array
    minItems: 1
    maxItems: 2
    description: Status register offsets for each mux block.

  realtek,intr-en:
    $ref: /schemas/types.yaml#/definitions/uint32-array
    minItems: 1
    maxItems: 2
    description: Enable register offsets for each mux block.

  interrupt-controller: true

  '#interrupt-cells':
    const: 2

required:
  - compatible
  - reg
  - interrupts
  - realtek,mux-nr
  - realtek,intr-status
  - realtek,intr-en
  - interrupt-controller
  - '#interrupt-cells'

additionalProperties: false

examples:
  - |
    interrupt-controller@9801b000 {
      compatible = "realtek,rtd1619-irq-mux";
      reg = <0x9801b000 0x100>, <0x98007000 0x100>;
      interrupts = <0 40 4>, <0 41 4>;
      realtek,mux-nr = <2>;
      realtek,intr-status = <0xc>, <0x0>;
      realtek,intr-en = <0x80>, <0x40>;
      interrupt-controller;
      #interrupt-cells = <2>;
    };
```

## drivers/net/wireless/unisoc/sprdwl/Kconfig
```kconfig
config UNISOC_SPRDWL
	tristate "sprdwl"
	depends on m
	depends on ARCH_MESON
	depends on CFG80211
	depends on UNISOC_UWE5621
	default m
	help
	  Build the Unisoc SPRDWL Wi-Fi driver.

	  When compiled as a module, this driver will be called sprdwl.
```

## drivers/net/wireless/unisoc/uwe5621/Kconfig
```kconfig
config UNISOC_UWE5621
	tristate "uwe5621"
	depends on m
	depends on ARCH_MESON
	default m
	help
	  Build the Unisoc UWE5621 WCN BSP support driver.

	  This option is intended for Amlogic UWE5621 platforms.
```

## drivers/pinctrl/realtek/Kconfig
```kconfig
config PINCTRL_RTD1619
	bool "Realtek RTD1619 pin controller driver"
	depends on ARCH_REALTEK
	default y
	select PINMUX
	select GENERIC_PINCONF
```

## drivers/soc/realtek/Kconfig
```kconfig
menu "Realtek Soc Drivers"

config REALTEK_CHIP
	tristate "Realtek 1xxx chip info"
	depends on ARCH_REALTEK
	help
	  This driver provides realtek chip info.

endmenu
```

## drivers/soc/rockchip/Kconfig
```kconfig
# SPDX-License-Identifier: GPL-2.0-only
if ARCH_ROCKCHIP || COMPILE_TEST

#
# Rockchip Soc drivers
#

config ROCKCHIP_GRF
	bool "Rockchip General Register Files support" if COMPILE_TEST
	default y if ARCH_ROCKCHIP
	help
	  The General Register Files are a central component providing
	  special additional settings registers for a lot of soc-components.
	  In a lot of cases there also need to be default settings initialized
	  to make some of them conform to expectations of the kernel.

config ROCKCHIP_IODOMAIN
	tristate "Rockchip IO domain support"
	depends on OF
	help
	  Say y here to enable support io domains on Rockchip SoCs. It is
	  necessary for the io domain setting of the SoC to match the
	  voltage supplied by the regulators.

config ROCKCHIP_DTPM
	tristate "Rockchip DTPM hierarchy"
	depends on DTPM && m
	help
	  Describe the hierarchy for the Dynamic Thermal Power Management tree
	  on this platform. That will create all the power capping capable
	  devices.

config ROCKCHIP_MISC_GPIO_A99
	bool "Rockchip YS-A99 misc GPIO defaults"
	depends on GPIOLIB
	default y
	help
	  Apply board-specific GPIO default states used by the YS-A99 Android
	  vendor tree, notably the func_io1 and func_io2 lines needed for
	  onboard SDIO WiFi bring-up.

config ROCKCHIP_MCU_7502
	bool "Rockchip YS-A99 MCU companion"
	depends on I2C
	default y
	help
	  Probe the YS-A99 board MCU over I2C early during boot. Android does
	  this shortly before the onboard FE1.1S USB2 hub enumerates.

endif
```

## drivers/thermal/realtek/Kconfig
```kconfig
# SPDX-License-Identifier: GPL-2.0-only

config REALTEK_RTD1619_THERMAL
	tristate "Realtek RTD1619 thermal sensor"
	depends on ARCH_REALTEK || COMPILE_TEST
	depends on OF
	depends on THERMAL_OF
	help
	  Enable thermal sensor support for Realtek RTD1619 SoCs.
```
